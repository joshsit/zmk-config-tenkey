## config/boards/shields/tenkey_taipo/Kconfig.defconfig
```kconfig
if SHIELD_TENKEY_TAIPO

config ZMK_KEYBOARD_NAME    
    default "Tenkey_Taipo"

endif
```

## config/boards/shields/tenkey_taipo/Kconfig.shield
```kconfig
config SHIELD_TENKEY_TAIPO
    def_bool $(shields_list_contains,tenkey_taipo)
    
```
